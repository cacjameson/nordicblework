## build/Kconfig/boards/Kconfig.nrf5340dk
```kconfig
# Load board Kconfig descriptions.
osource "C:/ncs/SDKs/v3.0.1/zephyr/boards/nordic/nrf5340dk/Kconfig.nrf5340dk"
```

## nRF5340-DK_build/Kconfig/boards/Kconfig.defconfig
```kconfig
# Load Zephyr board defconfig descriptions.
osource "C:/ncs/SDKs/v3.0.1/zephyr/boards/nordic/nrf5340dk/Kconfig.defconfig"
```

## nRF5340-DK_build/Kconfig/boards/Kconfig.sysbuild
```kconfig
# Load Sysbuild board Kconfig descriptions.
osource "C:/ncs/SDKs/v3.0.1/zephyr/boards/nordic/nrf5340dk/Kconfig.sysbuild"
```
